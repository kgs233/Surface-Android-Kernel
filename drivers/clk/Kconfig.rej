## drivers/clk/Kconfig.rej
```kconfig
--- drivers/clk/Kconfig
+++ drivers/clk/Kconfig
@@ -169,6 +169,12 @@ config COMMON_CLK_CDCE706
 	help
 	  This driver supports TI CDCE706 programmable 3-PLL clock synthesizer.
 
+config COMMON_CLK_TPS68470
+	tristate "Clock Driver for TI TPS68470 PMIC"
+	depends on I2C && REGMAP_I2C && INTEL_SKL_INT3472
+	help
+	 This driver supports the clocks provided by TPS68470
+
 config COMMON_CLK_CDCE925
 	tristate "Clock driver for TI CDCE913/925/937/949 devices"
 	depends on I2C
```

## drivers/media/i2c/Kconfig.rej
```kconfig
--- drivers/media/i2c/Kconfig
+++ drivers/media/i2c/Kconfig
@@ -1043,6 +1043,17 @@ config VIDEO_OV5675
 	  To compile this driver as a module, choose M here: the
 	  module will be called ov5675.
 
+config VIDEO_OV5693
+	tristate "OmniVision OV5693 sensor support"
+	depends on I2C && VIDEO_V4L2
+	select V4L2_FWNODE
+	help
+	  This is a Video4Linux2 sensor driver for the OmniVision
+	  OV5693 camera.
+
+	  To compile this driver as a module, choose M here: the
+	  module will be called ov5693.
+
 config VIDEO_OV5695
 	tristate "OmniVision OV5695 sensor support"
 	depends on I2C && VIDEO_V4L2
```

## drivers/platform/x86/Kconfig.rej
```kconfig
--- drivers/platform/x86/Kconfig
+++ drivers/platform/x86/Kconfig
@@ -901,15 +901,6 @@ config SURFACE_PRO3_BUTTON
 	help
 	  This driver handles the power/home/volume buttons on the Microsoft Surface Pro 3/4 tablet.
 
-config SURFACE_GPE
-	tristate "Surface GPE/Lid Driver"
-	depends on ACPI
-	help
-	  This driver marks the GPEs related to the ACPI lid device found on
-	  Microsoft Surface devices as wakeup sources and prepares them
-	  accordingly. It is required on those devices to allow wake-ups from
-	  suspend by opening the lid.
-
 config MSI_LAPTOP
 	tristate "MSI Laptop Extras"
 	depends on ACPI
```

## drivers/regulator/Kconfig.rej
```kconfig
--- drivers/regulator/Kconfig
+++ drivers/regulator/Kconfig
@@ -1339,6 +1339,15 @@ config REGULATOR_TPS65912
 	help
 	    This driver supports TPS65912 voltage regulator chip.
 
+config REGULATOR_TPS68470
+	tristate "TI TPS68370 PMIC Regulators Driver"
+	depends on INTEL_SKL_INT3472
+	help
+	  This driver adds support for the TPS68470 PMIC to register
+	  regulators against the usual framework.
+
+	  The module will be called "tps68470-regulator"
+
 config REGULATOR_TPS80031
 	tristate "TI TPS80031/TPS80032 power regulator driver"
 	depends on MFD_TPS80031
```
